## Documentation/devicetree/bindings/display/msm/qcom,kaanapali-mdss.yaml
```yaml
# SPDX-License-Identifier: GPL-2.0-only OR BSD-2-Clause
%YAML 1.2
---
$id: http://devicetree.org/schemas/display/msm/qcom,kaanapali-mdss.yaml#
$schema: http://devicetree.org/meta-schemas/core.yaml#

title: Qualcomm Kaanapali Display MDSS

maintainers:
  - Yongxing Mou <yongxing.mou@oss.qualcomm.com>

description:
  Kaanapali MSM Mobile Display Subsystem(MDSS), which encapsulates sub-blocks like
  DPU display controller, DSI and DP interfaces etc.

$ref: /schemas/display/msm/mdss-common.yaml#

properties:
  compatible:
    const: qcom,kaanapali-mdss

  clocks:
    items:
      - description: Display AHB
      - description: Display hf AXI
      - description: Display core

  iommus:
    maxItems: 1

  interconnects:
    items:
      - description: Interconnect path from mdp0 port to the data bus
      - description: Interconnect path from CPU to the reg bus

  interconnect-names:
    items:
      - const: mdp0-mem
      - const: cpu-cfg

patternProperties:
  "^display-controller@[0-9a-f]+$":
    type: object
    additionalProperties: true
    properties:
      compatible:
        const: qcom,kaanapali-dpu

  "^dsi@[0-9a-f]+$":
    type: object
    additionalProperties: true
    properties:
      compatible:
        contains:
          const: qcom,kaanapali-dsi-ctrl

  "^phy@[0-9a-f]+$":
    type: object
    additionalProperties: true
    properties:
      compatible:
        const: qcom,kaanapali-dsi-phy-3nm

required:
  - compatible

unevaluatedProperties: false

examples:
  - |
    #include <dt-bindings/clock/qcom,rpmh.h>
    #include <dt-bindings/interconnect/qcom,icc.h>
    #include <dt-bindings/interconnect/qcom,kaanapali-rpmh.h>
    #include <dt-bindings/interrupt-controller/arm-gic.h>
    #include <dt-bindings/phy/phy-qcom-qmp.h>
    #include <dt-bindings/power/qcom,rpmhpd.h>

    display-subsystem@ae00000 {
            compatible = "qcom,kaanapali-mdss";
            reg = <0x09800000 0x1000>;
            reg-names = "mdss";

            interrupts = <GIC_SPI 83 IRQ_TYPE_LEVEL_HIGH>;

            clocks = <&disp_cc_mdss_ahb_clk>,
                     <&gcc_disp_hf_axi_clk>,
                     <&disp_cc_mdss_mdp_clk>,
                     <&dispcc DISP_CC_MDSS_AHB_SWI_CLK>;

            interconnects = <&mmss_noc MASTER_MDP QCOM_ICC_TAG_ALWAYS
                             &mc_virt SLAVE_EBI1 QCOM_ICC_TAG_ALWAYS>,
                            <&gem_noc MASTER_APPSS_PROC QCOM_ICC_TAG_ACTIVE_ONLY
                             &config_noc SLAVE_DISPLAY_CFG QCOM_ICC_TAG_ACTIVE_ONLY>;
            interconnect-names = "mdp0-mem",
                                 "cpu-cfg";

            resets = <&dispcc DISP_CC_MDSS_CORE_BCR>;

           power-domains = <&dispcc DISP_CC_MDSS_CORE_GDSC>;

            iommus = <&apps_smmu 0x800 0x2>;

            interrupt-controller;
            #interrupt-cells = <1>;

            #address-cells = <1>;
            #size-cells = <1>;
            ranges;

            display-controller@ae01000 {
                compatible = "qcom,kaanapali-dpu";
                reg = <0x09801000 0x1C8000>,
                      <0x09B16000 0x3000>;
                reg-names = "mdp",
                            "vbif";

                interrupts-extended = <&mdss 0>;

                clocks = <&gcc_disp_hf_axi_clk>,
                         <&disp_cc_mdss_ahb_clk>,
                         <&disp_cc_mdss_mdp_lut_clk>,
                         <&disp_cc_mdss_mdp_clk>,
                         <&disp_cc_mdss_vsync_clk>,
                         <&disp_cc_mdss_ahb1_clk>;
                clock-names = "nrt_bus",
                              "iface",
                              "lut",
                              "core",
                              "vsync",
                              "iface1";

                assigned-clocks = <&disp_cc_mdss_vsync_clk>;
                assigned-clock-rates = <19200000>;

                operating-points-v2 = <&mdp_opp_table>;

                power-domains = <&rpmhpd RPMHPD_MMCX>,
                                <&dispcc DISP_CC_MDSS_CORE_INT2_GDSC>;

                ports {
                    #address-cells = <1>;
                    #size-cells = <0>;

                    port@0 {
                        reg = <0>;

                        dpu_intf1_out: endpoint {
                            remote-endpoint = <&mdss_dsi0_in>;
                        };
                    };

                    port@1 {
                        reg = <1>;

                        dpu_intf2_out: endpoint {
                            remote-endpoint = <&mdss_dsi1_in>;
                        };
                    };
                };

                mdp_opp_table: opp-table {
                    compatible = "operating-points-v2";

                    opp-207000000 {
                        opp-hz = /bits/ 64 <207000000>;
                        required-opps = <&rpmhpd_opp_low_svs>;
                    };

                    opp-337000000 {
                        opp-hz = /bits/ 64 <337000000>;
                        required-opps = <&rpmhpd_opp_svs>;
                    };

                    opp-417000000 {
                        opp-hz = /bits/ 64 <417000000>;
                        required-opps = <&rpmhpd_opp_svs_l1>;
                    };

                    opp-532000000 {
                        opp-hz = /bits/ 64 <532000000>;
                        required-opps = <&rpmhpd_opp_nom>;
                    };

                    opp-600000000 {
                        opp-hz = /bits/ 64 <600000000>;
                        required-opps = <&rpmhpd_opp_nom_l1>;
                    };

                    opp-650000000 {
                        opp-hz = /bits/ 64 <650000000>;
                        required-opps = <&rpmhpd_opp_turbo>;
                    };
                };
            };

            dsi@ae94000 {
                compatible = "qcom,kaanapali-dsi-ctrl", "qcom,mdss-dsi-ctrl";
                reg = <0x09ac0000 0x500>;
                reg-names = "dsi_ctrl";

                interrupts-extended = <&mdss 4>;

                clocks = <&disp_cc_mdss_byte0_clk>,
                         <&disp_cc_mdss_byte0_intf_clk>,
                         <&disp_cc_mdss_pclk0_clk>,
                         <&disp_cc_mdss_esc0_clk>,
                         <&disp_cc_mdss_ahb_clk>,
                         <&gcc_disp_hf_axi_clk>,
                         <&mdss_dsi0_phy 1>,
                         <&mdss_dsi0_phy 0>,
                         <&disp_cc_esync0_clk>,
                         <&disp_cc_osc_clk>,
                         <&disp_cc_mdss_byte0_clk_src>,
                         <&disp_cc_mdss_pclk0_clk_src>;
                clock-names = "byte",
                              "byte_intf",
                              "pixel",
                              "core",
                              "iface",
                              "bus",
                              "dsi_pll_pixel",
                              "dsi_pll_byte",
                              "esync",
                              "osc",
                              "byte_src",
                              "pixel_src";

                operating-points-v2 = <&mdss_dsi_opp_table>;

                power-domains = <&rpmhpd RPMHPD_MMCX>;

                phys = <&mdss_dsi0_phy>;
                phy-names = "dsi";

                vdda-supply = <&vreg_l3g_1p2>;

                #address-cells = <1>;
                #size-cells = <0>;

                ports {
                    #address-cells = <1>;
                    #size-cells = <0>;

                    port@0 {
                        reg = <0>;

                        mdss_dsi0_in: endpoint {
                            remote-endpoint = <&dpu_intf1_out>;
                        };
                    };

                    port@1 {
                        reg = <1>;

                        mdss_dsi0_out: endpoint {
                            remote-endpoint = <&panel0_in>;
                            data-lanes = <0 1 2 3>;
                        };
                    };
                };

                mdss_dsi_opp_table: opp-table {
                    compatible = "operating-points-v2";

                    opp-187500000 {
                        opp-hz = /bits/ 64 <187500000>;
                        required-opps = <&rpmhpd_opp_low_svs>;
                    };

                    opp-300000000 {
                        opp-hz = /bits/ 64 <300000000>;
                        required-opps = <&rpmhpd_opp_svs>;
                    };

                    opp-358000000 {
                        opp-hz = /bits/ 64 <358000000>;
                        required-opps = <&rpmhpd_opp_svs_l1>;
                    };
                };
            };

            mdss_dsi0_phy: phy@ae95000 {
                compatible = "qcom,kaanapali-dsi-phy-3nm", "qcom,sm8750-dsi-phy-3nm";
                reg = <0x09ac1000 0x200>,
                      <0x09ac1200 0x280>,
                      <0x09ac1500 0x400>;
                reg-names = "dsi_phy",
                            "dsi_phy_lane",
                            "dsi_pll";

                clocks = <&disp_cc_mdss_ahb_clk>,
                         <&rpmhcc RPMH_CXO_CLK>;
                clock-names = "iface",
                              "ref";

                vdds-supply = <&vreg_l3i_0p88>;

                #clock-cells = <1>;
                #phy-cells = <0>;
            };
        };
```
