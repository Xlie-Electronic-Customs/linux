## Documentation/devicetree/bindings/net/bluetooth/qcom,bluetooth-common.yaml
```yaml
# SPDX-License-Identifier: (GPL-2.0 OR BSD-2-Clause)
%YAML 1.2
---
$id: http://devicetree.org/schemas/net/bluetooth/qcom,bluetooth-common.yaml#
$schema: http://devicetree.org/meta-schemas/core.yaml#

title: Qualcomm Bluetooth Common Properties

maintainers:
  - Balakrishna Godavarthi <quic_bgodavar@quicinc.com>
  - Rocky Liao <quic_rjliao@quicinc.com>

properties:
  firmware-name:
    minItems: 1
    items:
      - description: specify the name of nvm firmware to load
      - description: specify the name of rampatch firmware to load

  qcom,local-bd-address-broken:
    type: boolean
    description:
      boot firmware is incorrectly passing the address in big-endian order

  qcom,brahma-peri-baudrate:
    type: boolean
    description:
      Indicates that the UART baud rate must be raised through the peripheral
      subsystem (the vendor peri-subsystem baud command) instead of the
      BT-subsystem vendor baud command. Needed by the WCN7860/BRAHMA combo
      chip, whose ROM silently ignores the BT-subsystem baud VSC. Must not be
      set on plain WCN7850 boards, which expect the standard BT-subsystem
      baud VSC.

additionalProperties: true
```

## arch/mips/configs/kn3810_defconfig
```kconfig
CONFIG_SYSVIPC=y
CONFIG_NO_HZ_IDLE=y
CONFIG_IKCONFIG=y
CONFIG_IKCONFIG_PROC=y
CONFIG_MEMCG=y
CONFIG_BLK_CGROUP=y
CONFIG_CFS_BANDWIDTH=y
CONFIG_CGROUP_PIDS=y
CONFIG_CGROUP_FREEZER=y
CONFIG_CPUSETS=y
CONFIG_CGROUP_DEVICE=y
CONFIG_CGROUP_CPUACCT=y
CONFIG_NAMESPACES=y
CONFIG_USER_NS=y
CONFIG_SCHED_AUTOGROUP=y
CONFIG_BLK_DEV_INITRD=y
CONFIG_BPF_SYSCALL=y
CONFIG_USERFAULTFD=y
CONFIG_EXPERT=y
# CONFIG_SLUB_DEBUG is not set
# CONFIG_COMPAT_BRK is not set
CONFIG_CPU_LITTLE_ENDIAN=y
CONFIG_MIPS_CPS=y
CONFIG_HIGHMEM=y
CONFIG_NR_CPUS=4
CONFIG_MIPS_O32_FP64_SUPPORT=y
CONFIG_JUMP_LABEL=y
CONFIG_MODULES=y
CONFIG_MODULE_UNLOAD=y
CONFIG_TRIM_UNUSED_KSYMS=y
CONFIG_NET=y
CONFIG_PACKET=y
CONFIG_UNIX=y
CONFIG_INET=y
CONFIG_IP_PNP=y
CONFIG_IP_PNP_DHCP=y
CONFIG_NETFILTER=y
# CONFIG_WIRELESS is not set
CONFIG_DEVTMPFS=y
CONFIG_DEVTMPFS_MOUNT=y
CONFIG_SCSI=y
CONFIG_HW_RANDOM=y
# CONFIG_HWMON is not set
CONFIG_MFD_SYSCON=y
CONFIG_HID_A4TECH=y
CONFIG_HID_APPLE=y
CONFIG_HID_BELKIN=y
CONFIG_HID_CHERRY=y
CONFIG_HID_CHICONY=y
CONFIG_HID_CYPRESS=y
CONFIG_HID_EZKEY=y
CONFIG_HID_KENSINGTON=y
CONFIG_HID_LOGITECH=y
CONFIG_HID_MICROSOFT=y
CONFIG_HID_MONTEREY=y
# CONFIG_MIPS_PLATFORM_DEVICES is not set
# CONFIG_IOMMU_SUPPORT is not set
CONFIG_EXT4_FS=y
CONFIG_EXT4_FS_POSIX_ACL=y
CONFIG_EXT4_FS_SECURITY=y
CONFIG_FS_ENCRYPTION=y
CONFIG_FANOTIFY=y
CONFIG_FUSE_FS=y
CONFIG_CUSE=y
CONFIG_OVERLAY_FS=y
CONFIG_MSDOS_FS=y
CONFIG_VFAT_FS=y
CONFIG_TMPFS=y
CONFIG_TMPFS_POSIX_ACL=y
CONFIG_NFS_FS=y
CONFIG_NFS_V3_ACL=y
CONFIG_NFS_V4=y
CONFIG_NFS_V4_1=y
CONFIG_NFS_V4_2=y
CONFIG_ROOT_NFS=y
# CONFIG_XZ_DEC_X86 is not set
# CONFIG_XZ_DEC_POWERPC is not set
# CONFIG_XZ_DEC_IA64 is not set
# CONFIG_XZ_DEC_ARM is not set
# CONFIG_XZ_DEC_ARMTHUMB is not set
# CONFIG_XZ_DEC_SPARC is not set
CONFIG_PRINTK_TIME=y
CONFIG_DEBUG_INFO_DWARF_TOOLCHAIN_DEFAULT=y
CONFIG_DEBUG_INFO_REDUCED=y
CONFIG_DEBUG_FS=y
# CONFIG_SCHED_DEBUG is not set
# CONFIG_FTRACE is not set
CONFIG_CMDLINE_BOOL=n

CONFIG_ECONET_EN7528=y
CONFIG_ARCH_FORCE_MAX_ORDER=11
CONFIG_CPU_MIPS32_R2=y

CONFIG_PCI=y
CONFIG_PCIEPORTBUS=y

CONFIG_MTD=y
CONFIG_MTD_NDM_PARTS=y
CONFIG_MTD_NDM_DUAL_IMAGE=y
CONFIG_MTD_NDM_U_STATE_SEARCH=y
CONFIG_MTD_NDM_U_STATE_SEARCH_START_BLOCK=0x1d7
CONFIG_MTD_NDM_U_STATE_SEARCH_END_BLOCK=0x1cd
CONFIG_MTD_NDM_CONFIG_SIZE=0x80000
CONFIG_MTD_NDM_DUMP_SIZE=0x40000
CONFIG_MTD_NDM_STORAGE_SIZE=0x0
CONFIG_MTD_NDM_FLASH_SIZE_LIMIT=0x2000000
CONFIG_MTD_NDM_EXTENDED_STORAGE=y

CONFIG_MTD_RAW_NAND=y
CONFIG_MTD_BLOCK=y

CONFIG_SERIAL_TC3162=y

CONFIG_MISC_FILESYSTEMS=y
CONFIG_SQUASHFS=y
CONFIG_SQUASHFS_FILE_DIRECT=y
CONFIG_SQUASHFS_DECOMP_MULTI_PERCPU=y
CONFIG_SQUASHFS_COMPILE_DECOMP_MULTI_PERCPU=y
CONFIG_SQUASHFS_XZ=y
CONFIG_SQUASHFS_4K_DEVBLK_SIZE=y
CONFIG_SQUASHFS_EMBEDDED=y
CONFIG_SQUASHFS_FRAGMENT_CACHE_SIZE=3
```

## drivers/input/touchscreen/oplus/oplus_touchscreen_v2/Focal/Kconfig
```kconfig
source "drivers/input/touchscreen/oplus/oplus_touchscreen_v2/Focal/ft3518/Kconfig"
source "drivers/input/touchscreen/oplus/oplus_touchscreen_v2/Focal/ft3658u/Kconfig"
source "drivers/input/touchscreen/oplus/oplus_touchscreen_v2/Focal/ft3658u_spi/Kconfig"
source "drivers/input/touchscreen/oplus/oplus_touchscreen_v2/Focal/ft3681/Kconfig"
```

## drivers/input/touchscreen/oplus/oplus_touchscreen_v2/Kconfig
```kconfig
config TOUCHIRQ_UPDATE_QOS
    bool "OPLUS touchpanel driver update qos"
    help
      Say Y here if you want to update qos value in irq handler.


config TOUCHPANEL_OPLUS
    tristate "OPLUS tp module"
    help
      Say Y here if you have touchscreen build into driver.
      Say M here if you have touchscreen as module.

config TOUCHPANEL_SYNAPTICS
    tristate "TP Synaptics_IC enable or not for OPLUS"
    help
    Say Y to enable driver for Touchpanel using Synaptics_IC
    Say M to enable driver for Touchpanel using Synaptics_IC as module.

if TOUCHPANEL_SYNAPTICS
source "drivers/input/touchscreen/oplus/oplus_touchscreen_v2/Synaptics/Kconfig"
endif
```

## drivers/input/touchscreen/oplus/oplus_touchscreen_v2/ilitek/Kconfig
```kconfig
source "drivers/input/touchscreen/oplus/oplus_touchscreen_v2/ilitek/ilitek9881h/Kconfig"
source "drivers/input/touchscreen/oplus/oplus_touchscreen_v2/ilitek/ilitek7807s/Kconfig"
```
